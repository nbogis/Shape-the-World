// SpaceInvaders.c
// Runs on LM4F120/TM4C123
// Jonathan Valvano and Daniel Valvano
// This is a starter project for the edX Lab 15
// In order for other students to play your game
// 1) You must leave the hardware configuration as defined
// 2) You must not add/remove any files from the project
// 3) You must add your code only this this C file
// I.e., if you wish to use code from sprite.c or sound.c, move that code in this file
// 4) It must compile with the 32k limit of the free Keil

// April 10, 2014
// http://www.spaceinvaders.de/
// sounds at http://www.classicgaming.cc/classics/spaceinvaders/sounds.php
// http://www.classicgaming.cc/classics/spaceinvaders/playguide.php
/* This example accompanies the books
   "Embedded Systems: Real Time Interfacing to Arm Cortex M Microcontrollers",
   ISBN: 978-1463590154, Jonathan Valvano, copyright (c) 2013

   "Embedded Systems: Introduction to Arm Cortex M Microcontrollers",
   ISBN: 978-1469998749, Jonathan Valvano, copyright (c) 2013

 Copyright 2014 by Jonathan W. Valvano, valvano@mail.utexas.edu
    You may use, edit, run or distribute this file
    as long as the above copyright notice remains
 THIS SOFTWARE IS PROVIDED "AS IS".  NO WARRANTIES, WHETHER EXPRESS, IMPLIED
 OR STATUTORY, INCLUDING, BUT NOT LIMITED TO, IMPLIED WARRANTIES OF
 MERCHANTABILITY AND FITNESS FOR A PARTICULAR PURPOSE APPLY TO THIS SOFTWARE.
 VALVANO SHALL NOT, IN ANY CIRCUMSTANCES, BE LIABLE FOR SPECIAL, INCIDENTAL,
 OR CONSEQUENTIAL DAMAGES, FOR ANY REASON WHATSOEVER.
 For more information about my classes, my research, and my books, see
 http://users.ece.utexas.edu/~valvano/
 */
// ******* Required Hardware I/O connections*******************
// Slide pot pin 1 connected to ground
// Slide pot pin 2 connected to PE2/AIN1
// Slide pot pin 3 connected to +3.3V 
// fire button connected to PE0
// special weapon fire button connected to PE1
// 8*R resistor DAC bit 0 on PB0 (least significant bit)
// 4*R resistor DAC bit 1 on PB1
// 2*R resistor DAC bit 2 on PB2
// 1*R resistor DAC bit 3 on PB3 (most significant bit)
// LED on PB4
// LED on PB5

// Blue Nokia 5110
// ---------------
// Signal        (Nokia 5110) LaunchPad pin
// Reset         (RST, pin 1) connected to PA7
// SSI0Fss       (CE,  pin 2) connected to PA3
// Data/Command  (DC,  pin 3) connected to PA6
// SSI0Tx        (Din, pin 4) connected to PA5
// SSI0Clk       (Clk, pin 5) connected to PA2
// 3.3V          (Vcc, pin 6) power
// back light    (BL,  pin 7) not connected, consists of 4 white LEDs which draw ~80mA total
// Ground        (Gnd, pin 8) ground

// Red SparkFun Nokia 5110 (LCD-10168)
// -----------------------------------
// Signal        (Nokia 5110) LaunchPad pin
// 3.3V          (VCC, pin 1) power
// Ground        (GND, pin 2) ground
// SSI0Fss       (SCE, pin 3) connected to PA3
// Reset         (RST, pin 4) connected to PA7
// Data/Command  (D/C, pin 5) connected to PA6
// SSI0Tx        (DN,  pin 6) connected to PA5
// SSI0Clk       (SCLK, pin 7) connected to PA2
// back light    (LED, pin 8) not connected, consists of 4 white LEDs which draw ~80mA total

#include "..//tm4c123gh6pm.h"
#include "Nokia5110.h"
#include "Random.h"
#include "TExaS.h"
#include <stdlib.h>
#include <stdbool.h>
// ***** 2. Global Declarations Section *****

// FUNCTION PROTOTYPES: Each subroutine defined
void DisableInterrupts(void); // Disable interrupts
void EnableInterrupts(void);  // Enable interrupts
void display(unsigned int,const unsigned char*);
void enemy_Movement(unsigned char,bool);
void PORTS_Init(void);
void DAC_Init(void);
void ADC0_Init(void);
unsigned long ADC_In(void);
unsigned char Player_Move(void);
void SysTick_Init(void);
void Timer2_Init(unsigned long);
void Delayms(unsigned long);
unsigned char Rand(unsigned char,unsigned char);

// GLOBAL VARIABLES DECLERATION
volatile unsigned long Fire;
volatile unsigned long Previous_Fire = 0;
unsigned char flag_sound;							// a flag to indicate firing
unsigned int Index_N = 0;							// index variable for normal firing 
unsigned int Index_S = 0;							// index variable for special firing
unsigned int Index_Ex = 0;						// index variable for explosion
unsigned long ADCdata;   						  // 12-bit 0 to 4095 sample
unsigned char R_number;								// random number varable
unsigned char Enemy_Rand;
unsigned long Previous_ADC;
unsigned long Player_Loc;
unsigned char missile_loc;
bool missile_flag = false;
bool explosion_flag = false;
unsigned char enemy_hit_flag = 0;	
unsigned char enemy_attack_flag;
const unsigned char *missile_image;
// *************************** Images ***************************
// enemy fly that starts at the top of the screen (with wings)
// width=16 x height=10
const unsigned char SmallEnemyNew1[] ={
 0x42, 0x4D, 0xC6, 0x00, 0x00, 0x00, 0x00, 0x00, 0x00, 0x00, 0x76, 0x00, 0x00, 0x00, 0x28, 0x00, 0x00, 0x00, 0x10, 0x00, 0x00, 0x00, 0x0A, 0x00, 0x00, 0x00, 0x01, 0x00, 0x04, 0x00, 0x00, 0x00,
 0x00, 0x00, 0x50, 0x00, 0x00, 0x00, 0x00, 0x00, 0x00, 0x00, 0x00, 0x00, 0x00, 0x00, 0x00, 0x00, 0x00, 0x00, 0x00, 0x00, 0x00, 0x00, 0x00, 0x00, 0x00, 0x00, 0x00, 0x00, 0x80, 0x00, 0x00, 0x80,
 0x00, 0x00, 0x00, 0x80, 0x80, 0x00, 0x80, 0x00, 0x00, 0x00, 0x80, 0x00, 0x80, 0x00, 0x80, 0x80, 0x00, 0x00, 0x80, 0x80, 0x80, 0x00, 0xC0, 0xC0, 0xC0, 0x00, 0x00, 0x00, 0xFF, 0x00, 0x00, 0xFF,
 0x00, 0x00, 0x00, 0xFF, 0xFF, 0x00, 0xFF, 0x00, 0x00, 0x00, 0xFF, 0x00, 0xFF, 0x00, 0xFF, 0xFF, 0x00, 0x00, 0xFF, 0xFF, 0xFF, 0x00, 0x00, 0x00, 0x00, 0x00, 0x00, 0x00, 0x00, 0x00, 0x00, 0x00,
 0x0F, 0xF0, 0x0F, 0xF0, 0x00, 0x00, 0x00, 0xF0, 0xF0, 0x00, 0x00, 0x0F, 0x0F, 0x00, 0x00, 0xFF, 0xFF, 0xFF, 0xFF, 0xFF, 0xFF, 0x00, 0x00, 0xFF, 0xFF, 0x0F, 0xF0, 0xFF, 0xFF, 0x00, 0x00, 0x0F,
 0xF0, 0x0F, 0xF0, 0x0F, 0xF0, 0x00, 0x00, 0xF0, 0xFF, 0xFF, 0xFF, 0xFF, 0x0F, 0x00, 0x0F, 0x00, 0x0F, 0x0F, 0xF0, 0xF0, 0x00, 0xF0, 0xF0, 0x00, 0xF0, 0x0F, 0xF0, 0x0F, 0x00, 0x0F, 0x0F, 0xFF,
 0x00, 0x00, 0x00, 0x00, 0xFF, 0xF0, 0xFF};

// enemy animal that starts at the top of the screen long teeth)
// width=16 x height=10
const unsigned char SmallEnemyNew2[] ={
 0x42, 0x4D, 0xC6, 0x00, 0x00, 0x00, 0x00, 0x00, 0x00, 0x00, 0x76, 0x00, 0x00, 0x00, 0x28, 0x00, 0x00, 0x00, 0x10, 0x00, 0x00, 0x00, 0x0A, 0x00, 0x00, 0x00, 0x01, 0x00, 0x04, 0x00, 0x00, 0x00,
 0x00, 0x00, 0x50, 0x00, 0x00, 0x00, 0x00, 0x00, 0x00, 0x00, 0x00, 0x00, 0x00, 0x00, 0x00, 0x00, 0x00, 0x00, 0x00, 0x00, 0x00, 0x00, 0x00, 0x00, 0x00, 0x00, 0x00, 0x00, 0x80, 0x00, 0x00, 0x80,
 0x00, 0x00, 0x00, 0x80, 0x80, 0x00, 0x80, 0x00, 0x00, 0x00, 0x80, 0x00, 0x80, 0x00, 0x80, 0x80, 0x00, 0x00, 0x80, 0x80, 0x80, 0x00, 0xC0, 0xC0, 0xC0, 0x00, 0x00, 0x00, 0xFF, 0x00, 0x00, 0xFF,
 0x00, 0x00, 0x00, 0xFF, 0xFF, 0x00, 0xFF, 0x00, 0x00, 0x00, 0xFF, 0x00, 0xFF, 0x00, 0xFF, 0xFF, 0x00, 0x00, 0xFF, 0xFF, 0xFF, 0x00, 0x00, 0x00, 0xF0, 0x00, 0x00, 0x0F, 0x00, 0x00, 0x00, 0x00,
 0xF0, 0x0F, 0xF0, 0x0F, 0x00, 0x00, 0x00, 0x00, 0xF0, 0xF0, 0x0F, 0x0F, 0x00, 0x00, 0x00, 0x0F, 0xFF, 0xFF, 0xFF, 0xFF, 0xF0, 0x00, 0x00, 0xFF, 0xFF, 0x0F, 0xF0, 0xFF, 0xFF, 0x00, 0x00, 0xFF,
 0xF0, 0xFF, 0xFF, 0x0F, 0xFF, 0x00, 0x00, 0x00, 0xFF, 0xFF, 0xFF, 0xFF, 0x00, 0x00, 0x00, 0x00, 0x0F, 0x00, 0x00, 0xF0, 0x00, 0x00, 0x00, 0x00, 0xF0, 0x00, 0x00, 0x0F, 0x00, 0x00, 0x00, 0x0F,
 0x00, 0x00, 0x00, 0x00, 0xF0, 0x00, 0xFF};

// enemy animal that starts in the middle of the screen (crazy deer)
// width=16 x height=10
const unsigned char SmallEnemyNew3[] ={
 0x42, 0x4D, 0xC6, 0x00, 0x00, 0x00, 0x00, 0x00, 0x00, 0x00, 0x76, 0x00, 0x00, 0x00, 0x28, 0x00, 0x00, 0x00, 0x10, 0x00, 0x00, 0x00, 0x0A, 0x00, 0x00, 0x00, 0x01, 0x00, 0x04, 0x00, 0x00, 0x00,
 0x00, 0x00, 0x50, 0x00, 0x00, 0x00, 0x00, 0x00, 0x00, 0x00, 0x00, 0x00, 0x00, 0x00, 0x00, 0x00, 0x00, 0x00, 0x00, 0x00, 0x00, 0x00, 0x00, 0x00, 0x00, 0x00, 0x00, 0x00, 0x80, 0x00, 0x00, 0x80,
 0x00, 0x00, 0x00, 0x80, 0x80, 0x00, 0x80, 0x00, 0x00, 0x00, 0x80, 0x00, 0x80, 0x00, 0x80, 0x80, 0x00, 0x00, 0x80, 0x80, 0x80, 0x00, 0xC0, 0xC0, 0xC0, 0x00, 0x00, 0x00, 0xFF, 0x00, 0x00, 0xFF,
 0x00, 0x00, 0x00, 0xFF, 0xFF, 0x00, 0xFF, 0x00, 0x00, 0x00, 0xFF, 0x00, 0xFF, 0x00, 0xFF, 0xFF, 0x00, 0x00, 0xFF, 0xFF, 0xFF, 0x00, 0x00, 0x00, 0x00, 0x0F, 0xF0, 0x00, 0x00, 0x00, 0x00, 0x00,
 0xFF, 0xF0, 0x0F, 0xFF, 0x00, 0x00, 0x00, 0x00, 0xFF, 0xFF, 0xFF, 0xFF, 0x00, 0x00, 0x00, 0x0F, 0xF0, 0x0F, 0xF0, 0x0F, 0xF0, 0x00, 0x00, 0x0F, 0xF0, 0x0F, 0xF0, 0x0F, 0xF0, 0x00, 0x00, 0x0F,
 0xFF, 0xFF, 0xFF, 0xFF, 0xF0, 0x00, 0x00, 0x00, 0xF0, 0xFF, 0xFF, 0x0F, 0x00, 0x00, 0x0F, 0x0F, 0x00, 0x00, 0x00, 0x00, 0xF0, 0xF0, 0x00, 0xF0, 0xF0, 0x00, 0x00, 0x0F, 0x0F, 0x00, 0x0F, 0x00,
 0x0F, 0x00, 0x00, 0xF0, 0x00, 0xF0, 0xFF};


// enemy ship that starts in the middle of the screen (one big eye with arms and legs)
// width=16 x height=10
const unsigned char SmallEnemynew[] ={
 0x42, 0x4D, 0xC6, 0x00, 0x00, 0x00, 0x00, 0x00, 0x00, 0x00, 0x76, 0x00, 0x00, 0x00, 0x28, 0x00, 0x00, 0x00, 0x10, 0x00, 0x00, 0x00, 0x0A, 0x00, 0x00, 0x00, 0x01, 0x00, 0x04, 0x00, 0x00, 0x00,
 0x00, 0x00, 0x50, 0x00, 0x00, 0x00, 0x00, 0x00, 0x00, 0x00, 0x00, 0x00, 0x00, 0x00, 0x00, 0x00, 0x00, 0x00, 0x00, 0x00, 0x00, 0x00, 0x00, 0x00, 0x00, 0x00, 0x00, 0x00, 0x80, 0x00, 0x00, 0x80,
 0x00, 0x00, 0x00, 0x80, 0x80, 0x00, 0x80, 0x00, 0x00, 0x00, 0x80, 0x00, 0x80, 0x00, 0x80, 0x80, 0x00, 0x00, 0x80, 0x80, 0x80, 0x00, 0xC0, 0xC0, 0xC0, 0x00, 0x00, 0x00, 0xFF, 0x00, 0x00, 0xFF,
 0x00, 0x00, 0x00, 0xFF, 0xFF, 0x00, 0xFF, 0x00, 0x00, 0x00, 0xFF, 0x00, 0xFF, 0x00, 0xFF, 0xFF, 0x00, 0x00, 0xFF, 0xFF, 0xFF, 0x00, 0x00, 0x00, 0x00, 0x00, 0x00, 0x00, 0x00, 0x00, 0x00, 0x0F,
 0xFF, 0xF0, 0x0F, 0xFF, 0xF0, 0x00, 0x00, 0xF0, 0xF0, 0x00, 0x00, 0x0F, 0x0F, 0x00, 0x00, 0xFF, 0xFF, 0xFF, 0xFF, 0xFF, 0xFF, 0x00, 0x00, 0xFF, 0x00, 0x00, 0x00, 0x00, 0xFF, 0x00, 0x00, 0xFF,
 0xF0, 0x00, 0x00, 0x0F, 0xFF, 0x00, 0x00, 0x0F, 0xFF, 0xFF, 0xFF, 0xFF, 0xF0, 0x00, 0x00, 0x00, 0x0F, 0xF0, 0x0F, 0xF0, 0x00, 0x00, 0x00, 0x00, 0xFF, 0x00, 0x00, 0xFF, 0x00, 0x00, 0x00, 0x00,
 0x00, 0x00, 0x00, 0x00, 0x00, 0x00, 0xFF};

// bonus to increase the player's ship live by 1
// width=12 x height=9
const unsigned char heart[] ={
 0x42, 0x4D, 0xBE, 0x00, 0x00, 0x00, 0x00, 0x00, 0x00, 0x00, 0x76, 0x00, 0x00, 0x00, 0x28, 0x00, 0x00, 0x00, 0x0C, 0x00, 0x00, 0x00, 0x09, 0x00, 0x00, 0x00, 0x01, 0x00, 0x04, 0x00, 0x00, 0x00,
 0x00, 0x00, 0x48, 0x00, 0x00, 0x00, 0x00, 0x00, 0x00, 0x00, 0x00, 0x00, 0x00, 0x00, 0x00, 0x00, 0x00, 0x00, 0x00, 0x00, 0x00, 0x00, 0x00, 0x00, 0x00, 0x00, 0x00, 0x00, 0x80, 0x00, 0x00, 0x80,
 0x00, 0x00, 0x00, 0x80, 0x80, 0x00, 0x80, 0x00, 0x00, 0x00, 0x80, 0x00, 0x80, 0x00, 0x80, 0x80, 0x00, 0x00, 0x80, 0x80, 0x80, 0x00, 0xC0, 0xC0, 0xC0, 0x00, 0x00, 0x00, 0xFF, 0x00, 0x00, 0xFF,
 0x00, 0x00, 0x00, 0xFF, 0xFF, 0x00, 0xFF, 0x00, 0x00, 0x00, 0xFF, 0x00, 0xFF, 0x00, 0xFF, 0xFF, 0x00, 0x00, 0xFF, 0xFF, 0xFF, 0x00, 0x00, 0x00, 0x00, 0x00, 0x00, 0x00, 0x00, 0x00, 0x00, 0x00,
 0x09, 0x90, 0x00, 0x00, 0x00, 0x00, 0x00, 0x00, 0x99, 0x99, 0x00, 0x00, 0x00, 0x00, 0x00, 0x09, 0x99, 0x99, 0x90, 0x00, 0x00, 0x00, 0x00, 0x99, 0x99, 0x99, 0x99, 0x00, 0x00, 0x00, 0x09, 0x99,
 0x99, 0x99, 0x99, 0x90, 0x00, 0x00, 0x09, 0x99, 0x90, 0x09, 0x99, 0x90, 0x00, 0x00, 0x00, 0x99, 0x00, 0x00, 0x99, 0x00, 0x00, 0x00, 0x00, 0x00, 0x00, 0x00, 0x00, 0x00, 0x00, 0x00, 0xFF
};


// player's animal with ring sheild (health level = 3 - complete)
// width=16 x height=12
const unsigned char PlayerSheildCatNew[] ={
 0x42, 0x4D, 0xD6, 0x00, 0x00, 0x00, 0x00, 0x00, 0x00, 0x00, 0x76, 0x00, 0x00, 0x00, 0x28, 0x00, 0x00, 0x00, 0x10, 0x00, 0x00, 0x00, 0x0C, 0x00, 0x00, 0x00, 0x01, 0x00, 0x04, 0x00, 0x00, 0x00,
 0x00, 0x00, 0x60, 0x00, 0x00, 0x00, 0xC4, 0x0E, 0x00, 0x00, 0xC4, 0x0E, 0x00, 0x00, 0x00, 0x00, 0x00, 0x00, 0x00, 0x00, 0x00, 0x00, 0x00, 0x00, 0x00, 0x00, 0x00, 0x00, 0x80, 0x00, 0x00, 0x80,
 0x00, 0x00, 0x00, 0x80, 0x80, 0x00, 0x80, 0x00, 0x00, 0x00, 0x80, 0x00, 0x80, 0x00, 0x80, 0x80, 0x00, 0x00, 0x80, 0x80, 0x80, 0x00, 0xC0, 0xC0, 0xC0, 0x00, 0x00, 0x00, 0xFF, 0x00, 0x00, 0xFF,
 0x00, 0x00, 0x00, 0xFF, 0xFF, 0x00, 0xFF, 0x00, 0x00, 0x00, 0xFF, 0x00, 0xFF, 0x00, 0xFF, 0xFF, 0x00, 0x00, 0xFF, 0xFF, 0xFF, 0x00, 0x00, 0x00, 0x00, 0xBB, 0xBB, 0x00, 0x00, 0x00, 0x00, 0x00,
 0x0B, 0x00, 0x00, 0xB0, 0x00, 0x00, 0x00, 0x00, 0xB0, 0x0B, 0xB0, 0x0B, 0x00, 0x00, 0x00, 0xBB, 0x00, 0x00, 0x00, 0x00, 0xB0, 0x00, 0x00, 0xB0, 0x0B, 0x00, 0x00, 0xB0, 0x0B, 0x00, 0x00, 0xB0,
 0x00, 0x00, 0x00, 0x00, 0x0B, 0x00, 0x00, 0x0B, 0x0B, 0xBB, 0xBB, 0xB0, 0xB0, 0x00, 0x00, 0xB0, 0xB0, 0x00, 0x00, 0x0B, 0x0B, 0x00, 0x00, 0x0B, 0x00, 0x00, 0x00, 0x00, 0xB0, 0x00, 0x00, 0x99,
 0x99, 0x99, 0x99, 0x99, 0x99, 0x00, 0x00, 0x90, 0x00, 0x00, 0x00, 0x00, 0x09, 0x00, 0x00, 0x99, 0x99, 0x99, 0x99, 0x99, 0x99, 0x00, 0xFF};

// player's animal broken ring sheild  (health level = 2 - damaged)
// width=16 x height=12
const unsigned char PlayerBrokenSheildCatNew[] ={
 0x42, 0x4D, 0xD6, 0x00, 0x00, 0x00, 0x00, 0x00, 0x00, 0x00, 0x76, 0x00, 0x00, 0x00, 0x28, 0x00, 0x00, 0x00, 0x10, 0x00, 0x00, 0x00, 0x0C, 0x00, 0x00, 0x00, 0x01, 0x00, 0x04, 0x00, 0x00, 0x00,
 0x00, 0x00, 0x60, 0x00, 0x00, 0x00, 0xC4, 0x0E, 0x00, 0x00, 0xC4, 0x0E, 0x00, 0x00, 0x00, 0x00, 0x00, 0x00, 0x00, 0x00, 0x00, 0x00, 0x00, 0x00, 0x00, 0x00, 0x00, 0x00, 0x80, 0x00, 0x00, 0x80,
 0x00, 0x00, 0x00, 0x80, 0x80, 0x00, 0x80, 0x00, 0x00, 0x00, 0x80, 0x00, 0x80, 0x00, 0x80, 0x80, 0x00, 0x00, 0x80, 0x80, 0x80, 0x00, 0xC0, 0xC0, 0xC0, 0x00, 0x00, 0x00, 0xFF, 0x00, 0x00, 0xFF,
 0x00, 0x00, 0x00, 0xFF, 0xFF, 0x00, 0xFF, 0x00, 0x00, 0x00, 0xFF, 0x00, 0xFF, 0x00, 0xFF, 0xFF, 0x00, 0x00, 0xFF, 0xFF, 0xFF, 0x00, 0x00, 0x00, 0x00, 0xBB, 0xBB, 0x00, 0x00, 0x00, 0x00, 0x00,
 0x0B, 0x00, 0x00, 0xB0, 0x00, 0x00, 0x00, 0x00, 0xB0, 0x0B, 0xB0, 0x0B, 0x00, 0x00, 0x00, 0xBB, 0x00, 0x00, 0x00, 0x00, 0xB0, 0x00, 0x00, 0xB0, 0x0B, 0x00, 0x00, 0xB0, 0x0B, 0x00, 0x00, 0xB0,
 0x00, 0x00, 0x00, 0x00, 0x0B, 0x00, 0x00, 0x0B, 0x0B, 0xBB, 0xBB, 0xB0, 0xB0, 0x00, 0x00, 0xB0, 0xB0, 0x00, 0x00, 0x0B, 0x0B, 0x00, 0x00, 0x0B, 0x00, 0x00, 0x00, 0x00, 0xB0, 0x00, 0x00, 0x99,
 0x09, 0x90, 0x99, 0x09, 0x09, 0x00, 0x00, 0x00, 0x00, 0x00, 0x00, 0x00, 0x09, 0x00, 0x00, 0x99, 0x00, 0x09, 0x90, 0x00, 0x90, 0x00, 0xFF};


// image of the player's animal (health level = 1)
// includes two blacked out columns on the left and right sides of the image to prevent smearing when moved 2 pixels to the left or right
// width=16 x height=12
const unsigned char PlayerCatNew[] ={
 0x42, 0x4D, 0xD6, 0x00, 0x00, 0x00, 0x00, 0x00, 0x00, 0x00, 0x76, 0x00, 0x00, 0x00, 0x28, 0x00, 0x00, 0x00, 0x10, 0x00, 0x00, 0x00, 0x0C, 0x00, 0x00, 0x00, 0x01, 0x00, 0x04, 0x00, 0x00, 0x00,
 0x00, 0x00, 0x60, 0x00, 0x00, 0x00, 0xC4, 0x0E, 0x00, 0x00, 0xC4, 0x0E, 0x00, 0x00, 0x00, 0x00, 0x00, 0x00, 0x00, 0x00, 0x00, 0x00, 0x00, 0x00, 0x00, 0x00, 0x00, 0x00, 0x80, 0x00, 0x00, 0x80,
 0x00, 0x00, 0x00, 0x80, 0x80, 0x00, 0x80, 0x00, 0x00, 0x00, 0x80, 0x00, 0x80, 0x00, 0x80, 0x80, 0x00, 0x00, 0x80, 0x80, 0x80, 0x00, 0xC0, 0xC0, 0xC0, 0x00, 0x00, 0x00, 0xFF, 0x00, 0x00, 0xFF,
 0x00, 0x00, 0x00, 0xFF, 0xFF, 0x00, 0xFF, 0x00, 0x00, 0x00, 0xFF, 0x00, 0xFF, 0x00, 0xFF, 0xFF, 0x00, 0x00, 0xFF, 0xFF, 0xFF, 0x00, 0x00, 0x00, 0x00, 0xBB, 0xBB, 0x00, 0x00, 0x00, 0x00, 0x00,
 0x0B, 0x00, 0x00, 0xB0, 0x00, 0x00, 0x00, 0x00, 0xB0, 0x0B, 0xB0, 0x0B, 0x00, 0x00, 0x00, 0xBB, 0x00, 0x00, 0x00, 0x00, 0xB0, 0x00, 0x00, 0xB0, 0x0B, 0x00, 0x00, 0xB0, 0x0B, 0x00, 0x00, 0xB0,
 0x00, 0x00, 0x00, 0x00, 0x0B, 0x00, 0x00, 0x0B, 0x0B, 0xBB, 0xBB, 0xB0, 0xB0, 0x00, 0x00, 0xB0, 0xB0, 0x00, 0x00, 0x0B, 0x0B, 0x00, 0x00, 0x0B, 0x00, 0x00, 0x00, 0x00, 0xB0, 0x00, 0x00, 0x00,
 0x00, 0x00, 0x00, 0x00, 0x00, 0x00, 0x00, 0x00, 0x00, 0x00, 0x00, 0x00, 0x00, 0x00, 0x00, 0x00, 0x00, 0x00, 0x00, 0x00, 0x00, 0x00, 0xFF};


 
// large explosion that can be used upon the demise of the player's ship (first frame)
// width=18 x height=8
const unsigned char BigExplosion0[] = {
 0x42, 0x4D, 0xD6, 0x00, 0x00, 0x00, 0x00, 0x00, 0x00, 0x00, 0x76, 0x00, 0x00, 0x00, 0x28, 0x00, 0x00, 0x00, 0x12, 0x00, 0x00, 0x00, 0x08, 0x00, 0x00, 0x00, 0x01, 0x00, 0x04, 0x00, 0x00, 0x00,
 0x00, 0x00, 0x60, 0x00, 0x00, 0x00, 0x00, 0x00, 0x00, 0x00, 0x00, 0x00, 0x00, 0x00, 0x00, 0x00, 0x00, 0x00, 0x00, 0x00, 0x00, 0x00, 0x00, 0x00, 0x00, 0x00, 0x00, 0x00, 0x80, 0x00, 0x00, 0x80,
 0x00, 0x00, 0x00, 0x80, 0x80, 0x00, 0x80, 0x00, 0x00, 0x00, 0x80, 0x00, 0x80, 0x00, 0x80, 0x80, 0x00, 0x00, 0x80, 0x80, 0x80, 0x00, 0xC0, 0xC0, 0xC0, 0x00, 0x00, 0x00, 0xFF, 0x00, 0x00, 0xFF,
 0x00, 0x00, 0x00, 0xFF, 0xFF, 0x00, 0xFF, 0x00, 0x00, 0x00, 0xFF, 0x00, 0xFF, 0x00, 0xFF, 0xFF, 0x00, 0x00, 0xFF, 0xFF, 0xFF, 0x00, 0x0A, 0x00, 0x09, 0x00, 0x00, 0x00, 0x90, 0x00, 0x00, 0x00,
 0x00, 0x00, 0x00, 0x90, 0x00, 0x90, 0xB0, 0x0A, 0x00, 0x0B, 0x00, 0x00, 0x00, 0x00, 0x00, 0x0B, 0x00, 0x0B, 0x00, 0x00, 0x00, 0x00, 0x00, 0x00, 0x00, 0x00, 0x0B, 0xA0, 0x00, 0xE0, 0x00, 0x00,
 0x90, 0x90, 0x9A, 0x00, 0x00, 0x00, 0x00, 0x00, 0xA0, 0x00, 0x00, 0xE0, 0x00, 0x00, 0x00, 0x00, 0x00, 0x00, 0x00, 0x90, 0x00, 0x00, 0xA0, 0x00, 0x00, 0xAE, 0x00, 0x00, 0x00, 0x00, 0x0A, 0x00,
 0x00, 0xE0, 0x0A, 0x0A, 0x00, 0x00, 0xB0, 0x00, 0x00, 0x00, 0xA0, 0x00, 0x09, 0x00, 0x00, 0x00, 0x90, 0x00, 0x0A, 0x00, 0x00, 0x00, 0xFF};


// small explosion best used for the demise of an enemy
// width=16 x height=10
const unsigned char SmallExplosion0[] = {
 0x42, 0x4D, 0xC6, 0x00, 0x00, 0x00, 0x00, 0x00, 0x00, 0x00, 0x76, 0x00, 0x00, 0x00, 0x28, 0x00, 0x00, 0x00, 0x10, 0x00, 0x00, 0x00, 0x0A, 0x00, 0x00, 0x00, 0x01, 0x00, 0x04, 0x00, 0x00, 0x00,
 0x00, 0x00, 0x50, 0x00, 0x00, 0x00, 0x00, 0x00, 0x00, 0x00, 0x00, 0x00, 0x00, 0x00, 0x00, 0x00, 0x00, 0x00, 0x00, 0x00, 0x00, 0x00, 0x00, 0x00, 0x00, 0x00, 0x00, 0x00, 0x80, 0x00, 0x00, 0x80,
 0x00, 0x00, 0x00, 0x80, 0x80, 0x00, 0x80, 0x00, 0x00, 0x00, 0x80, 0x00, 0x80, 0x00, 0x80, 0x80, 0x00, 0x00, 0x80, 0x80, 0x80, 0x00, 0xC0, 0xC0, 0xC0, 0x00, 0x00, 0x00, 0xFF, 0x00, 0x00, 0xFF,
 0x00, 0x00, 0x00, 0xFF, 0xFF, 0x00, 0xFF, 0x00, 0x00, 0x00, 0xFF, 0x00, 0xFF, 0x00, 0xFF, 0xFF, 0x00, 0x00, 0xFF, 0xFF, 0xFF, 0x00, 0x00, 0x00, 0x00, 0x00, 0x00, 0x00, 0x00, 0x00, 0x00, 0xF0,
 0x0F, 0x00, 0x0F, 0x00, 0xF0, 0x00, 0x00, 0x0F, 0x00, 0xF0, 0xF0, 0x0F, 0x00, 0x00, 0x00, 0x00, 0xF0, 0x00, 0x00, 0xF0, 0x00, 0x00, 0x0F, 0xF0, 0x00, 0x00, 0x00, 0x00, 0xFF, 0x00, 0x00, 0x00,
 0xF0, 0x00, 0x00, 0xF0, 0x00, 0x00, 0x00, 0x0F, 0x00, 0x00, 0x00, 0x0F, 0x00, 0x00, 0x00, 0xF0, 0x00, 0xF0, 0xF0, 0x00, 0xF0, 0x00, 0x00, 0x00, 0x0F, 0x00, 0x0F, 0x00, 0x00, 0x00, 0x00, 0x00,
 0x00, 0x00, 0x00, 0x00, 0x00, 0x00, 0xFF};

// a missile in flight
// includes one blacked out row on the top, bottom, and right of the image to prevent smearing when moved 1 pixel down, up, or left
// width=4 x height=9
const unsigned char Missile0[] = {
 0x42, 0x4D, 0x9A, 0x00, 0x00, 0x00, 0x00, 0x00, 0x00, 0x00, 0x76, 0x00, 0x00, 0x00, 0x28, 0x00, 0x00, 0x00, 0x04, 0x00, 0x00, 0x00, 0x09, 0x00, 0x00, 0x00, 0x01, 0x00, 0x04, 0x00, 0x00, 0x00,
 0x00, 0x00, 0x24, 0x00, 0x00, 0x00, 0x00, 0x00, 0x00, 0x00, 0x00, 0x00, 0x00, 0x00, 0x00, 0x00, 0x00, 0x00, 0x00, 0x00, 0x00, 0x00, 0x00, 0x00, 0x00, 0x00, 0x00, 0x00, 0x80, 0x00, 0x00, 0x80,
 0x00, 0x00, 0x00, 0x80, 0x80, 0x00, 0x80, 0x00, 0x00, 0x00, 0x80, 0x00, 0x80, 0x00, 0x80, 0x80, 0x00, 0x00, 0x80, 0x80, 0x80, 0x00, 0xC0, 0xC0, 0xC0, 0x00, 0x00, 0x00, 0xFF, 0x00, 0x00, 0xFF,
 0x00, 0x00, 0x00, 0xFF, 0xFF, 0x00, 0xFF, 0x00, 0x00, 0x00, 0xFF, 0x00, 0xFF, 0x00, 0xFF, 0xFF, 0x00, 0x00, 0xFF, 0xFF, 0xFF, 0x00, 0x00, 0x00, 0x00, 0x00, 0x0F, 0x00, 0x00, 0x00, 0xF0, 0x00,
 0x00, 0x00, 0x0F, 0x00, 0x00, 0x00, 0x00, 0xF0, 0x00, 0x00, 0x0F, 0x00, 0x00, 0x00, 0xF0, 0x00, 0x00, 0x00, 0x0F, 0x00, 0x00, 0x00, 0x00, 0x00, 0x00, 0x00, 0xFF};

// a laser burst in flight
// includes one blacked out row on the top and bottom of the image to prevent smearing when moved 1 pixel up or down
// width=2 x height=9
const unsigned char Laser0[] = {
 0x42, 0x4D, 0x9A, 0x00, 0x00, 0x00, 0x00, 0x00, 0x00, 0x00, 0x76, 0x00, 0x00, 0x00, 0x28, 0x00, 0x00, 0x00, 0x02, 0x00, 0x00, 0x00, 0x09, 0x00, 0x00, 0x00, 0x01, 0x00, 0x04, 0x00, 0x00, 0x00,
 0x00, 0x00, 0x24, 0x00, 0x00, 0x00, 0x00, 0x00, 0x00, 0x00, 0x00, 0x00, 0x00, 0x00, 0x00, 0x00, 0x00, 0x00, 0x00, 0x00, 0x00, 0x00, 0x00, 0x00, 0x00, 0x00, 0x00, 0x00, 0x80, 0x00, 0x00, 0x80,
 0x00, 0x00, 0x00, 0x80, 0x80, 0x00, 0x80, 0x00, 0x00, 0x00, 0x80, 0x00, 0x80, 0x00, 0x80, 0x80, 0x00, 0x00, 0x80, 0x80, 0x80, 0x00, 0xC0, 0xC0, 0xC0, 0x00, 0x00, 0x00, 0xFF, 0x00, 0x00, 0xFF,
 0x00, 0x00, 0x00, 0xFF, 0xFF, 0x00, 0xFF, 0x00, 0x00, 0x00, 0xFF, 0x00, 0xFF, 0x00, 0xFF, 0xFF, 0x00, 0x00, 0xFF, 0xFF, 0xFF, 0x00, 0x00, 0x00, 0x00, 0x00, 0x99, 0x00, 0x00, 0x00, 0xBB, 0x00,
 0x00, 0x00, 0xAA, 0x00, 0x00, 0x00, 0xFF, 0x00, 0x00, 0x00, 0xFF, 0x00, 0x00, 0x00, 0xFF, 0x00, 0x00, 0x00, 0xFF, 0x00, 0x00, 0x00, 0x00, 0x00, 0x00, 0x00, 0xFF};

// sound for shooting normal missile shoot[4080]
unsigned char shoot[] = {8,6,6,10,13,8,2,6,12,7,3,5,8,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7,7};
// sound for shooting normal missile shoot[1802]
unsigned char highpitch[] = {15,9,6,6,3,0,3,3,7,9,9,10,10,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12,};
unsigned char explosion[] = {7,7,7,7,7,7,8,8,8,8,7,7,7,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8,8};
	
unsigned char bad_guy[]= {6,6,6,6,6};				// array to hold which enemy is alive. default to unrecognized value (only 5 enemies)
const unsigned char *characters[] = {SmallEnemynew,SmallEnemyNew1,SmallEnemyNew2,SmallEnemyNew3,SmallEnemynew};
const unsigned long positons[] = {0,16,32,48,64};

struct State {
	unsigned long x;      // x coordinate
	unsigned long y;      // y coordinate
	const unsigned char *image; // ptr->image
	char life;            // 0=dead, 1=alive
};          
typedef struct State STyp;
STyp Enemy[5];
	
// ************** Capture image dimensions out of BMP**********
#define BUNKERW     ((unsigned char)Bunker0[18])
#define BUNKERH     ((unsigned char)Bunker0[22])
#define ENEMY30W    ((unsigned char)SmallEnemyNew3[18])
#define ENEMY30H    ((unsigned char)SmallEnemyNew3[22])
#define ENEMY20W    ((unsigned char)SmallEnemyNew2[18])
#define ENEMY20H    ((unsigned char)SmallEnemyNew2[22])
#define ENEMY10W    ((unsigned char)SmallEnemyNew1[18])
#define ENEMY10H    ((unsigned char)SmallEnemyNew1[22])
#define ENEMYBONUSW ((unsigned char)SmallEnemyBonus0[18])
#define ENEMYBONUSH ((unsigned char)SmallEnemyBonus0[22])
#define LASERW      ((unsigned char)Laser0[18])
#define LASERH      ((unsigned char)Laser0[22])
#define MISSILEW    ((unsigned char)Missile0[18])
#define MISSILEH    ((unsigned char)Missile0[22])
#define PLAYERW     ((unsigned char)PlayerShip0[18])
#define PLAYERH     ((unsigned char)PlayerShip0[22])
	 
int main (void){
	unsigned char level = 1;
	unsigned char  number_of_Enemies = 0;
  unsigned char shuffle[]= {0,1,2,3,4};				// array to shuffle between enemies
	//	unsigned char Enemy_position;
	unsigned int i,n = ENEMY10H - 1;
	unsigned char t,tmp;				
	unsigned char explosion_flag = 6;					// unrecognized value
	unsigned char enemy_move_flag;
	unsigned char all_dead_flag;
	bool attack_flag = false;
	unsigned char Player_life = 3;
	const unsigned char* Player_image = PlayerSheildCatNew;
	char String[7]="LEVEL  ";

	TExaS_Init(SSI0_Real_Nokia5110_Scope);  // set system clock to 80 MHz
	ADC0_Init();
	DAC_Init();
	Nokia5110_Init();
  Timer2_Init(7111);							// initiate Timer 2 at 11.25kHz
	SysTick_Init();

	EnableInterrupts();
  Nokia5110_Clear();
  Nokia5110_SetCursor(1, 1);
  Nokia5110_OutString("Welcome To");
  Nokia5110_SetCursor(3, 3);
  Nokia5110_OutString("ANIMAL");
  Nokia5110_SetCursor(0, 4);
  Nokia5110_OutString("* INVADERS *");
	while ((GPIO_PORTE_DATA_R & 0x03) == 0x00);
	srand(NVIC_ST_CURRENT_R);
	Delayms(100);
	enemy_hit_flag = 0;
	
	while(1){	
		Nokia5110_ClearBuffer();
		if (Player_life == 0){
			Nokia5110_Clear();
			Nokia5110_SetCursor(1, 2);
			Nokia5110_OutString("GAME OVER");
			level = 1;											// back to level 1 when the player died
			Delayms(500);
			continue;
		}		
		if (number_of_Enemies  == 0){				// display enemeis and player for the first time
			//** block to handle displaying current  level
			Nokia5110_Clear();
			Nokia5110_SetCursor(3, 2);
			String[6]=level+0x30;
			Nokia5110_OutString(String);
			Delayms(300);
			
			for (i=0;i<5;i++){
				Enemy[i].x = positons[i];
				Enemy[i].y = ENEMY10H - 1;
				Enemy[i].image = characters[i];
				Enemy[i].life = 0;					// enemies start as dead
			}
			///// block to handle first level's enemies choice and display. We shuffle the shuffle array to get us random enemy sequence
			// bad_guy array will only have level number of elements meaningful
			for (t=0;t<level;t++){
				Enemy_Rand = Rand(1,5);						// first enemy creation
				Enemy_Rand--;		
				tmp = shuffle[t];
				shuffle[t] = shuffle[Enemy_Rand];
				shuffle[Enemy_Rand] = tmp;
				// finished shuffling
			}
			for (t=0;t<level;t++){
				bad_guy[t] = shuffle[t];
				Enemy[bad_guy[t]].life = 1;
				number_of_Enemies++;
				Enemy[bad_guy[t]].image = characters[bad_guy[t]]; 	// reset the image of dead enemy
				Enemy[bad_guy[t]].x = positons[bad_guy[t]];					// reset location of deadenemy
			}
			i=8;
			all_dead_flag = number_of_Enemies;
			if (level == 1){
				Player_Loc = Rand(0,64);
			}
			display(35,Player_image);					// value of i doesn't matter for the first time
			continue;							// skip to the next iteration
		}
		Player_Loc = Player_Move();
	
		///// block to handle when the player fires a missile
		if (enemy_hit_flag ==1){	// when a missile is firing
			///// block to handle first time a missile is fired
			if (missile_flag == false){
				i = 8;
				missile_loc = Player_Loc+7;
				missile_flag = true;
			}
			///// block to handles enemy explosion
			if (explosion_flag == 6){ // when an enemy is hit
				for (t=0;t<level;t++){
					if ((Enemy[bad_guy[t]].life == 1) &&(missile_loc >= Enemy[bad_guy[t]].x)&&(missile_loc <= Enemy[bad_guy[t]].x+15) &&
						((48-i) <= Enemy[bad_guy[t]].y+10)){
						Enemy[bad_guy[t]].image = SmallExplosion0;
						explosion_flag = true;
						missile_flag = false;
						explosion_flag = bad_guy[t];
						enemy_hit_flag = 2;	
						break;						// keep t value to define which enemy is exploding
					}
				}
			}
			///// block to handle moving missiles
		  if (i> 35){							// if the missile reached the top
				i = 13;
				enemy_hit_flag = 0;
				missile_flag = false;
			}
			else {									// if the missile is on its way
				i += 5;
			}
		}
			///// block to handle after explosion. No enemy shown
		else if(enemy_hit_flag == 2){			//!!!!!!! make it back to 0 in the next level
			Enemy[explosion_flag].life = 0;
			missile_flag = false;
			explosion_flag = 6;					// reset explosion flag to finish explosion
			enemy_hit_flag = 0;
			number_of_Enemies--;							// decrease number of enemies in a level
			all_dead_flag--;									// decrement the dead flag
		}
		///// block to handle enemy movements
		else{ 					// move enemy if a missile is not fired
			enemy_move_flag = Rand(0,10);
			if ((enemy_move_flag%5) == 0){						// move enemy around
				for (t=0;t<level;t++){			// for each enemy ...
					enemy_move_flag = Rand(0,100);				// randomize the enemy movement
					// move the enemy
					if ((enemy_move_flag % 5)==0){				// if enemy moves
						//// check the neigboring enemies
						if(Enemy[bad_guy[t]].life == 0){			// skip if current enemy is dead
							continue;
						}
						// check enemies on the furthest left and right
						if (Enemy[bad_guy[t]].x == 0){// if current enemy is in the furthest left
							enemy_Movement(t,false);					// move to the right
						}
						else if (Enemy[bad_guy[t]].x == 64){// if current enemy is in the furthest right
							enemy_Movement(t,true);						// move to the left
						}
						else{																// if current enemy is in the middle
							enemy_move_flag = Rand(0,50);			// randomize moving left or right
							if ((enemy_move_flag%5) == 0){							// check the right
								enemy_Movement(t, false);				// move to the right if possible
							}
							else{															// check the left
								enemy_Movement(t, true);				// move to the left if possible
							}
						}
					}
				}
			}
			//**** block to check enemy's attack ****//
			else{																			// move an enemy to attack
				if (n == ENEMY10H-1){											// first time checking for an attack
					enemy_attack_flag = Rand(0,100);				// randomize the enemy movement
					if ((enemy_attack_flag%10) == 0){				// enemy attacks
						do{
						enemy_attack_flag = Rand(1,5)-1;				// randomize which enemy attacks
						}while (Enemy[bad_guy[enemy_attack_flag]].life != 1);
						attack_flag = true;
					}
				}
				if (attack_flag == true){
					if (n > 44){
						n = ENEMY10H-1;
						attack_flag = false;
						if (Enemy[bad_guy[enemy_attack_flag]].x == Player_Loc){
							Player_life--;
						}
						Enemy[bad_guy[enemy_attack_flag]].y = ENEMY10H-1;		// go back to the top
					}
					else{
						n += 12;
						Enemy[bad_guy[enemy_attack_flag]].y = n;
					}
				}
				switch (Player_life){
					case 3: 
						Player_image = PlayerSheildCatNew;
						break;
					case 2:
						Player_image = PlayerBrokenSheildCatNew;
						break;
					case 1:
						Player_image = PlayerCatNew;
						break;
					case 0:
						Player_image = SmallExplosion0;
						break;
				}
			}
		}
		display(i,Player_image);
		Delayms(50);  					//!!!! for board: 200         
		//**** block to check if player is ready to go to the next level ****//
		if (all_dead_flag == 0){	// increment the level when all enemies are dead
			if(level !=5){				// increment when the level is not the last level
				level++;
			}		
			// reset flags
			number_of_Enemies = 0;
		}
	}
}

void display(unsigned int i,const unsigned char* image){
		int t;
		Nokia5110_PrintBMP(Player_Loc, 47, image, 0);
		if (missile_flag == true){
			Nokia5110_PrintBMP(missile_loc, 48-i, missile_image, 0);
		}
		//Nokia5110_PrintBMP(60, 45, heart, 1);
		for (t=0;t<5;t++){
			if (Enemy[t].life == 1){
				Nokia5110_PrintBMP(Enemy[t].x, Enemy[t].y, Enemy[t].image,0);
			}
		}
		Nokia5110_DisplayBuffer(); // draw buffer
}

void enemy_Movement(unsigned char t, bool RorL){
	unsigned char tmp;
	unsigned char check_enemy = 0;
	for (tmp=0;tmp<5;tmp++){
		if (tmp == t){
			continue;										// don't compare same enemies
		}
		if (RorL == false){						// if we check enemies on the right
			if ((Enemy[tmp].life==1)&&((Enemy[tmp].x) == (Enemy[bad_guy[t]].x+16))){			// if there is enemy on the right
				break;
			}
		}
		else{													// if we check enemies on the left
			if ((Enemy[tmp].life==1)&&((Enemy[tmp].x) == (Enemy[bad_guy[t]].x-16))){			// if there is enemy on the left
				break;
			}
		}
		check_enemy++;
	}
	if (check_enemy == 4){					// if we checked all the other enemies 
		if(RorL == false){						// if we check enemies on the right 
			Enemy[bad_guy[t]].x += 16;	// move right
		}	
		else{													// if we check enemies on the left
			Enemy[bad_guy[t]].x -= 16;	// move left
		}
	}
}


// **************ADC0_Init*********************
// ADC initialization for the slider pot
// Input: none
// Output: none
// Note: Max sample rate: <=125,000 samples/second
// 			SS3 triggering event: software trigger
// 			SS3 1st sample source:  channel 1
// 			SS3 interrupts: enabled but not promoted to controller
void ADC0_Init(void){ 
	volatile unsigned long delay;
	SYSCTL_RCGC2_R |= 0x00000010;			// activate clock on port E
	delay = SYSCTL_RCGC2_R;	
	GPIO_PORTE_DIR_R &= ~0x04;				// make PE2 input (channel 1)
	GPIO_PORTE_AMSEL_R |= 0x04; 			// enable analog function on PE2
	GPIO_PORTE_AFSEL_R |= 0x04;				// enable alternate function on PE2
	GPIO_PORTE_DEN_R &= ~0x04;				// disable digital I/O on PE2
	
	// initiate device driver. Initialize ADC0, channel 1, sequencer 3
	SYSCTL_RCGC0_R |= 0x00010000;			// activiate ADC0
	delay = SYSCTL_RCGC0_R;
	SYSCTL_RCGC0_R &= ~0x00000300;		// configure for 125k
	ADC0_SSPRI_R = 0x0123;						// make sequencer 3 the highest proprity
	ADC0_ACTSS_R &= ~0x0008;					// disable seq 3
	ADC0_EMUX_R &= ~0xF000;						// set bit 15-12 for software trigger (seq3)
	ADC0_SSMUX3_R &= ~0x000F;					// clear SS3 field
	ADC0_SSMUX3_R += 1;								// set channel 1 (Ain1 = PE2)
	ADC0_SSCTL3_R = 0x0006;						// TS0 = 0 measure analog voltage on PE2 (ADC analog input pin)
																		// IE0 = 1 to set INR3 flag in ADC0_RIS_R when ADC conversion completes
																		// END0 = 1 this sample is the end of the sequence
																		// D0 = 0 sample single-ended analog input
	ADC0_ACTSS_R |= 0x0008;						// enable seq 3  
}

//*********************ADC0_In************************
// Busy-wait Analog to digital conversion
// Input: none
// Output: 12-bit result of ADC conversion
// Note: read from FIFO when a flag is set inidcating
// 			data is ready then acknowledge completion of
//			reading
unsigned long ADC0_In(void){  
	unsigned long result;
	ADC0_PSSI_R = 0x0008;							// initiate SS3
	while ((ADC0_RIS_R&0x08)==0){};		// wait until flag is set
	result = ADC0_SSFIFO3_R&0xFFF;		// read result from FIFO of sequencer 3
	ADC0_ISC_R = 0x0008;							// clear RIS by clearing bit 3 in ISC	to acknowledge completion
  return result; 										// return result
}
// **************Player_Move*********************
// subroutine to control player's moves
// Input: ADC value
// Output: 
// Note: ...
unsigned char Player_Move(void){ 
	unsigned char distance;
	unsigned long adc = 0;
	int i;

  for (i=0;i<5;i++){					// average 5 ADC readings
		adc += ADCdata;
	}
	adc /= 5;
	if (adc < 80){
		distance = 0;
	}
	else if((adc >=80)&&(adc < 130)){
		distance = 16;
	}
	else if((adc >=130)&&(adc < 160)){
		distance = 32;
	}
	else if((adc >=160)&&(adc < 270)){
		distance = 48;
	}
	else{
		distance = 64;
	}
	return distance;
}
// **************SysTick_Init*********************
// System clock initialization to run at 30 Hz 
// Input: None
// Output: None
// Note: clock initialization with priority of 0
//				for buttons, LEDs, and slider pot
void SysTick_Init(void){ 
	// pins configuration
  PORTS_Init();												// initialize switched and LEDs ports
	
	// SysTick interrupt configuration
	NVIC_ST_CTRL_R = 0; 								// disable SysTick during initialization
	NVIC_ST_RELOAD_R = 2666665; 				// reload value for 30 Hz (1/60 interrupt)
	NVIC_ST_CURRENT_R = 0; 							// write to current to clear it
	NVIC_SYS_PRI3_R = (NVIC_SYS_PRI3_R& 0x00FFFFFF);//|0x20000000;	// set priority 1
	NVIC_ST_CTRL_R = 0x00000007;				// enable clock and interrupt 
}

// *******************SysTick_Handler***********************
// Timer handler to check for switch pressing, flashing LED,
// and detecting pot movement
// Input: None
// Output: None
// Note: if player is shooting the normal missle (PE0), normal LED (PB4) toggle
// 			 if player is shooting the special missle (PE1), special LED (PB5)toggle
//		   Slide pot pin 1 connected to ground,Slide pot pin 2 connected to PE2/AIN1 and
// 			 Slide pot pin 3 connected to +3.3V 
void SysTick_Handler(void){
	ADCdata = ADC0_In();
	if (enemy_hit_flag == 0){					// only one missile can be fired at a time
		if (Fire == 0x01){				
			missile_image = Missile0;
			if ((Previous_Fire == 0)|| (Previous_Fire == 2)){
				enemy_hit_flag = 1;
				R_number = Rand(80,5);
				flag_sound = 1;										// set flag to 1 to indicate normal firing
				Previous_Fire = 1;
			}
			GPIO_PORTB_DATA_R ^= 0x10;				// toggle PB4
		}
		else if (Fire == 0x02){
			missile_image = Laser0;
			if ((Previous_Fire == 0) || (Previous_Fire == 1)){
				enemy_hit_flag = 1;
				srand(NVIC_ST_CURRENT_R);
				R_number = Rand(80,5);
				flag_sound = 2;										// set flag to 2 to indicate special firing
				Previous_Fire = 2;
			}
			GPIO_PORTB_DATA_R ^= 0x20;				// toggle PB5
		}
		else{
			GPIO_PORTB_DATA_R = 0x00;				// turn off both LEDs
			flag_sound = 0;									// reset flag 
			Previous_Fire = 0;
		}
	}
}

// **************PORTS_Init*********************
// Subroutine to initialize port E for the switches (used to fire weapons) and port B for the LEDs (used to fire indication)
// PE0 and PE1 are inputs, and PB4 and PB5 are outputs
// Inputs: None
// Output: None
// Notes: PE0 is used to fire normal weapon which toggles PB4 while PE1 is for firing the special weapon that toggles PB5
void PORTS_Init(void){
	volatile unsigned long delay;
	
	SYSCTL_RCGC2_R |= 0x00000012;			// 1) enable port E and B clock
	delay = SYSCTL_RCGC2_R; 					// delay
	
	// port E initialization
	GPIO_PORTE_AMSEL_R &= ~0x03;			// 2) disable analog function 
	GPIO_PORTE_PCTL_R	&= ~0x000000FF;	// 3) PCTL GPIO on PE0 and PE1 (to select regular digital function)
	GPIO_PORTE_DIR_R &= ~0x03; 				// 4) set PE0 and PE1 as inputs
	GPIO_PORTE_AFSEL_R &= ~0x03; 			// 5) clear bits in alternate function
	GPIO_PORTE_DEN_R |= 0x03;					// 6) enable digital pins PE0 and PE1
	
	// port B initialization
	GPIO_PORTB_AMSEL_R = 0x00;				// 2) disable analog function
	GPIO_PORTB_PCTL_R	= 0x00000000;		// 3) PCTL GPIO on PB4 and PB5 (to select reular digital function)
	GPIO_PORTB_DIR_R |= 0x30; 				// 4) set PB4 and PB5 as outputs
	GPIO_PORTB_AFSEL_R = 0x00; 				// 5) clear bits in alternate function
	GPIO_PORTB_DEN_R |= 0x30;					// 6) enable digital pins PB4 and PB5
}

// **************DAC_Init*********************
// Subroutine to initialize a 4-bit DAC to make sounds
// Inputs: None
// Output: None
// Notes: The DAC uses the ports PB0-3
// 				This subroutine runs at 11kHz interrupt
void DAC_Init(void){
	unsigned long volatile delay;
	SYSCTL_RCGC2_R |= SYSCTL_RCGC2_GPIOB;	// activiate clock on port B
	delay = SYSCTL_RCGC2_R;
	GPIO_PORTB_AMSEL_R = ~0x0F;						// disable analog function on PB3-0
	GPIO_PORTB_PCTL_R = ~0x0000FFFF;			// enable digital function on PB3-0
	GPIO_PORTB_DR8R_R |= 0x0F;						// enable 8mA drive on PB3-0
	GPIO_PORTB_DIR_R |= 0x0F;						  // make PB3-0 outputs
	GPIO_PORTB_AFSEL_R &= ~0x0F;					// diable alternate function (enable regular function) on PB3-0
	GPIO_PORTB_DEN_R |= 0x0F;							// enable digital port
}

// **************DAC_Out*********************
// output to DAC
// Input: 4-bit data, 0 to 15 
// Output: none
void DAC_Out(unsigned long data){
	GPIO_PORTB_DATA_R = data;							// output data to DAC
}

// **************Timer2_Init*********************
// Timer to play sounds
// Input: period (the divider for the frequency)
// Output: None
// Note: this timer has priority of 0 and runs at 11kHz 
void Timer2_Init(unsigned long period){ 
  unsigned long volatile delay;
  SYSCTL_RCGCTIMER_R |= 0x04;   // 0) activate timer2
  delay = SYSCTL_RCGCTIMER_R;
  TIMER2_CTL_R = 0x00000000;    // 1) disable timer2A during setup
  TIMER2_CFG_R = 0x00000000;    // 2) configure for 32-bit mode
  TIMER2_TAMR_R = 0x00000002;   // 3) configure for periodic mode, default down-count settings
  TIMER2_TAILR_R = period-1;    // 4) reload value
  TIMER2_TAPR_R = 0;            // 5) bus clock resolution
  TIMER2_ICR_R = 0x00000001;    // 6) clear timer2A timeout flag
  TIMER2_IMR_R = 0x00000001;    // 7) arm timeout interrupt
  NVIC_PRI5_R = (NVIC_PRI5_R&0x00FFFFFF); // 8) priority 0
// interrupts enabled in the main program after all devices initialized
// vector number 39, interrupt number 23
  NVIC_EN0_R = 1<<23;           // 9) enable IRQ 23 in NVIC
  TIMER2_CTL_R = 0x00000001;    // 10) enable timer2A
}

// **************Timer2_Handler*********************
// Handler to handle timer events 
// Input: None
// Output: None
// Note: This timre reads a flag set by SysTick and 
// 				sound the sound for firing accordingly 
void Timer2A_Handler(void){
  TIMER2_ICR_R = 0x00000001;   				// acknowledge timer2A timeout
	Fire = GPIO_PORTE_DATA_R & 0x03;		// reading the switches
	if (flag_sound == 1){								// if switch (PE0) is pressed
		if (Index_N<1802){								// 1802 is the size of the highpitch array
			Index_N = (Index_N+1)&0x7FF;		// index to cycle over sin wave (0x7FF would cycle over the 1802 table)
			DAC_Out(highpitch[Index_N]);		// output the sine wave value to DAC
		}
	}
	else if (flag_sound == 2){
		if (Index_S < 4080){							// 4080 is the size of the shoot array
			Index_S = (Index_S+1)&0xFFF;		// index to cycle over sin wave (0xFFF would cycle over the 4080 table)
			DAC_Out(shoot[Index_S]);				// output the sine wave value to DAC
		}
	}
	else{
		GPIO_PORTB_DATA_R = 0x00;		
		Index_N = Index_S = 0;						// reset indeces
	}
	if (explosion_flag == true){
		if (Index_Ex < 8731){							// 8731 is the size of the explosion array
			Index_Ex = (Index_Ex+1)&0x3FFF;		// 0x3FFF would cycle over the 4080 table
			DAC_Out(explosion[Index_Ex]);				// output the sine wave value to DAC
		}
	}
}
// **************Delayms*********************
// Subroutine to add a delay
// Inputs: number of 1ms delays
// Output: None
// Notes: assumes 80 MHz clock
void Delayms(unsigned long ms){
	unsigned long delay;
	while (ms>0){
		delay = 16000;
 		while (delay > 0){
			delay -= 1;
		}
		ms -= 1;
	}
}

// ***********************Rand**************************
// Random number generator between specified two numbers
// Inputs: high: maximum number
//					low: minimum number
// Output: unisgned char that is the generated random number
// Notes: ...
unsigned char Rand(unsigned char low, unsigned char high){
	unsigned char number;
	number = ((rand()>>24)%high)+1;			// random number between low-hight 
	if (number <= low){
		number = low;
	}
	return number; 
}

